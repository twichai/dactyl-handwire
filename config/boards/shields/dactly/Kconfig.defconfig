## config/boards/shields/dactly/Kconfig.defconfig
```kconfig
if DACTLY_LEFT

# Name must be less than 16 characters long!
config ZMK_KEYBOARD_NAME
    default "dactly"

config ZMK_SPLIT_ROLE_CENTRAL
    default y

config ZMK_SPLIT_BLE_CENTRAL_BATTERY_LEVEL_FETCHING
    default y

endif

if DACTLY_RIGHT
config ZMK_SPLIT_BLE_CENTRAL_BATTERY_LEVEL_PROXY
    default y
endif

if DACTLY_LEFT || DACTLY_RIGHT

config ZMK_SPLIT
    default y

endif
```

## config/boards/shields/dactly/Kconfig.shield
```kconfig
# No whitespace after the comma or in your part name!
config DACTLY_LEFT
    def_bool $(shields_list_contains,dactly_left)

# No whitespace after the comma or in your part name!
config DACTLY_RIGHT
    def_bool $(shields_list_contains,dactly_right)
```
